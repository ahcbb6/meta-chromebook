## conf/distro/chronos.conf
```bitbake
require conf/distro/poky.conf

DISTRO = "chronos"
DISTRO_NAME = "Chronos (Poky based Linux for Chromebooks)"
DISTRO_VERSION = "1.0"
DISTROOVERRIDES = "poky:chronos"

MAINTAINER = "Alejandro Hernandez Samaniego <alejandro@enedino.org>"

# x11 is required for the XFCE image, and pam is required
# to start the xserver by a non-root user.
DISTRO_FEATURES_append = " x11 pam"
```

## conf/layer.conf
```bitbake
# We have a conf and classes directory, add to BBPATH
BBPATH .= ":${LAYERDIR}"

# We have recipes-* directories, add to BBFILES
BBFILES += "${LAYERDIR}/recipes-*/*/*.bb \
            ${LAYERDIR}/recipes-*/*/*.bbappend"

BBFILE_COLLECTIONS += "meta-chromebook"
BBFILE_PATTERN_meta-chromebook = "^${LAYERDIR}/"
BBFILE_PRIORITY_meta-chromebook = "6"

LAYERDEPENDS_meta-chromebook = "core"
LAYERDEPENDS_meta-chromebook += "intel"
LAYERDEPENDS_meta-chromebook += "openembedded-layer"
LAYERDEPENDS_meta-chromebook += "meta-python"
LAYERDEPENDS_meta-chromebook += "networking-layer"


LAYERRECOMMENDS_meta-chromebook += "xfce-layer"
LAYERRECOMMENDS_meta-chromebook += "gnome-layer"
LAYERRECOMMENDS_meta-chromebook += "browser-layer"
LAYERRECOMMENDS_meta-chromebook += "clang-layer"

LAYERSERIES_COMPAT_meta-chromebook = "dunfell zeus warrior"

BB_DANGLINGAPPENDS_WARNONLY = "1"
```

## conf/machine/arm64-chromebook.conf
```bitbake
#@TYPE: Machine
#@NAME: arm64-chromebook

#@DESCRIPTION: Machine configuration for 64 arm processors
# most arm chromebooks come with a cortex-a53 or cortex-a72 for example.
# This MACHINE should work on most of them

DEFAULTTUNE ?= "generic-armv8"

require conf/machine/include/arm/arch-armv8a.inc

TUNEVALID[generic-armv8] = "Enable arm v8 optimizations"

AVAILTUNES += "generic-armv8"

ARMPKGARCH_tune-generic-armv8             = "generic-armv8"

TUNE_FEATURES_tune-generic-armv8          = "${TUNE_FEATURES_tune-aarch64} generic-armv8"
PACKAGE_EXTRA_ARCHS_tune-generic-armv8    = "${PACKAGE_EXTRA_ARCHS_tune-aarch64}"


IMAGE_FSTYPES += "wic"

# It is yet to be tested what works best for arm Chromebooks
WKS_FILE="directdisk-gpt.wks"

# Since this MACHINE should work on most arm64 chromebooks, we have to rely on kernel-modules being installed.
MACHINE_ESSENTIAL_EXTRA_RRECOMMENDS_append = " kernel-modules linux-firmware"


# Not a huge fan of setting this on a MACHINE.conf, but apparently this is the
# way its wired in, setting it on an image recipe wouldn't work, and otherwise
# it would have to be set on several bbappends.
# This allows us to run Xorg as a non root user
ROOTLESS_X = "1"


PREFERRED_PROVIDER_virtual/kernel = "linux-yocto"
PREFERRED_VERSION_linux-yocto = "5.%"

KERNEL_IMAGETYPE_arm64-chromebook = "Image"
```

## conf/machine/eve-chromebook.conf
```bitbake
#@TYPE: Machine
#@NAME: eve-chromebook

#@DESCRIPTION: Machine configuration for 64 bit Intel Core i7 CPU (at this point supporting Kaby Lake / Skylake) with all their possible extensions.

# This file is based on meta-intel intel-corei7 MACHINE, but it provides compatibility with newer
# generations of the architecture (they are still at Nehalem).

# The Skylake tune uses linux-intel as default, comment the following to use it if desired
PREFERRED_PROVIDER_virtual/kernel ?= "linux-yocto"
PREFERRED_VERSION_linux-yocto  = "5.%"


# Keep the same structure as meta-intel
require conf/machine/include/meta-intel.inc
require conf/machine/include/x86-base.inc
require conf/machine/include/tune-skylake.inc
require conf/machine/include/intel-common-pkgarch.inc

MACHINE_FEATURES += "efi"
MACHINE_FEATURES += "wifi 3g nfc"
MACHINE_FEATURES += "intel-ucode"

MACHINE_FEATURES += "pcbios"
MACHINE_FEATURES += "alsa"

MACHINE_HWCODECS ?= "intel-vaapi-driver gstreamer1.0-vaapi"


XSERVER ?= "${XSERVER_X86_BASE} \
            ${XSERVER_X86_EXT} \
            ${XSERVER_X86_FBDEV} \
            ${XSERVER_X86_I915} \
            ${XSERVER_X86_I965} \
            ${XSERVER_X86_MODESETTING} \
            ${XSERVER_X86_VESA} \
            ${XSERVER_X86_ASPEED_AST} \
           "

SYSLINUX_OPTS = "serial 0 115200"
SERIAL_CONSOLES = "115200;ttyS0 115200;ttyS1 115200;ttyS2"
APPEND += "rootwait console=ttyS0,115200 console=tty0"


IMAGE_FSTYPES += "wic"
# Support only systemd-boot at this point, the chromebooks only allow you to boot in Legacy boot (BIOS) mode anyway.
# WKS_FILE ?= "${@bb.utils.contains_any("EFI_PROVIDER", "systemd-boot", "systemd-bootdisk-microcode.wks.in", "grub-bootdisk-microcode.wks.in", d)}"
# WKS file that supports the legacy boot mode along with EFI
WKS_FILE="systemd-bootdisk-microcode-legacy.wks.in"
WKS_FILE_DEPENDS_append = " intel-microcode"

# Specify the required kernel modules (and firmware) for the specific HW on this MACHINE
# Drivers/Firmware
MACHINE_ESSENTIAL_EXTRA_RRECOMMENDS_append = " kernel-module-i915 linux-firmware-i915 kernel-module-iwlwifi linux-firmware-iwlwifi-7265d kernel-module-iwlmvm linux-firmware-ibt-hw-37-8 kernel-module-cfg80211 kernel-module-mac80211"


# Needed for QEMU, although at this point -cpu Skylake-{Slient,Server} has some issues
IMAGE_CLASSES += "qemuboot"

QB_SYSTEM_NAME_eve-chromebook = "qemu-system-x86_64"
QB_CPU_eve-chromebook = "-cpu Skylake-Client"
QB_CPU_KVM_eve-chromebook = "-cpu kvm64"

QB_AUDIO_DRV = "alsa"
QB_AUDIO_OPT = "-soundhw ac97,es1370"
QB_KERNEL_CMDLINE_APPEND = "vga=0 uvesafb.mode_option=640x480-32 oprofile.timer=1 uvesafb.task_timeout=-1"
# Add the 'virtio-rng-pci' device otherwise the guest may run out of entropy
QB_OPT_APPEND = "-vga vmware -show-cursor -usb -usbdevice tablet -device virtio-rng-pci"



# Not a huge fan of setting this on a MACHINE.conf, but apparently this is the
# way its wired in, setting it on an image recipe wouldn't work, and otherwise
# it would have to be set on several bbappends.
# This allows us to run Xorg as a non root user
ROOTLESS_X = "1"

# qemu-usermode is removed from MACHINE_FEATURES on the tune-skylake.inc file,
# we need to add it back to be able to build all components properly
INHERIT += "qemuuser-enable-chromebook"

# Branch used for chromium tools, e.g. vboot, flashrom
CHROMIUM_THIRDPARTY_BRANCH = "release-R80-12739.B"

# Needed to build MrChromebox tools
CHROMIUM_CPU_VARIANT = "kbl"
```

## conf/machine/include/intel-coreix-64-common.inc
```bitbake
#
# Common configuration for all MACHINES of the intel-corei7-64 type
#

# Based on Intel-corei7 but support newer architectures

DEFAULTTUNE ?= "coreix-64-skylake"
require conf/machine/include/tune-skylake.inc
require conf/machine/include/x86-base.inc
```

## conf/machine/include/tune-skylake.inc
```bitbake
# Settings for the GCC(1) cpu-type "skylake":
#
#     Intel Skylake CPU with 64-bit extensions, MMX, SSE, SSE2, SSE3, SSSE3, SSE4.1,
#     SSE4.2 and POPCNT instruction set support.
#
# This tune is recommended for Intel Skylake architectures (and beyond).
#

DEFAULTTUNE ?= "coreix-64-skylake"

# Include the previous tune to pull in PACKAGE_EXTRA_ARCHS
require conf/machine/include/tune-corei7.inc # tunei7 includes tune core2

# Extra tune features
TUNEVALID[skylake] = "Enable corei7 specific processor optimizations"
TUNE_CCARGS .= "${@bb.utils.contains('TUNE_FEATURES', 'skylake', ' -march=skylake -mtune=skylake -mfpmath=sse -msse4.2', '', d)}"


# Only support 64 bit at this point


# Extra tune selections
# AVAILTUNES += "corei7-32"
# TUNE_FEATURES_tune-corei7-32 = "${TUNE_FEATURES_tune-x86} corei7"
# BASE_LIB_tune-corei7-32 = "lib"
# TUNE_PKGARCH_tune-corei7-32 = "corei7-32"
# PACKAGE_EXTRA_ARCHS_tune-corei7-32 = "${PACKAGE_EXTRA_ARCHS_tune-core2-32} corei7-32"
# QEMU_EXTRAOPTIONS_corei7-32 = " -cpu Skylake,check=false"

AVAILTUNES += "coreix-64-skylake"
TUNE_FEATURES_tune-coreix-64-skylake = "${TUNE_FEATURES_tune-x86-64} skylake"
BASE_LIB_tune-coreix-64-skylake = "lib64"
TUNE_PKGARCH_tune-coreix-64-skylake = "coreix-64-skylake"
PACKAGE_EXTRA_ARCHS_tune-coreix-64-skylake = "${PACKAGE_EXTRA_ARCHS_tune-core2-64} coreix-64-skylake"

# Keep Skylake for emulation
QEMU_EXTRAOPTIONS_coreix-64-skylake = " -cpu Skylake-Client,check=false"

# AVAILTUNES += "corei7-64-x32"
# TUNE_FEATURES_tune-corei7-64-x32 = "${TUNE_FEATURES_tune-x86-64-x32} corei7"
# BASE_LIB_tune-corei7-64-x32 = "libx32"
# TUNE_PKGARCH_tune-corei7-64-x32 = "corei7-64-x32"
# PACKAGE_EXTRA_ARCHS_tune-corei7-64-x32 = "${PACKAGE_EXTRA_ARCHS_tune-core2-64-x32} corei7-64-x32"
# QEMU_EXTRAOPTIONS_corei7-64-x32 = " -cpu Skylake,check=false"
```

## conf/machine/mediatek8173-chromebook.conf
```bitbake
#@TYPE: Machine
#@NAME: mediatek8173-chromebook (hana)
#@BASEBOARD: oak

#@DESCRIPTION: Machine configuration for 64 mediatek 8173 arm processors, most arm chromebooks come with a cortex-a53 or cortex-a72 for example.
# This MACHINE should work on the mediatek 8173 variant

DEFAULTTUNE ?= "generic-armv8"

require conf/machine/include/arm/arch-armv8a.inc

TUNEVALID[generic-armv8] = "Enable arm v8 optimizations"

AVAILTUNES += "generic-armv8"

ARMPKGARCH_tune-generic-armv8             = "generic-armv8"

TUNE_FEATURES_tune-generic-armv8          = "${TUNE_FEATURES_tune-aarch64} generic-armv8"
PACKAGE_EXTRA_ARCHS_tune-generic-armv8    = "${PACKAGE_EXTRA_ARCHS_tune-aarch64} generic-armv8"


# TODO
# IMAGE_FSTYPES += "wic"
# # It is yet to be tested what works best for arm Chromebooks
# WKS_FILE="directdisk-gpt.wks"

# Since this MACHINE should work on most arm64 chromebooks, we have to rely on kernel-modules being installed.
MACHINE_ESSENTIAL_EXTRA_RRECOMMENDS_append = " kernel-modules linux-firmware"


# Not a huge fan of setting this on a MACHINE.conf, but apparently this is the
# way its wired in, setting it on an image recipe wouldn't work, and otherwise
# it would have to be set on several bbappends.
# This allows us to run Xorg as a non root user
ROOTLESS_X = "1"


# This machine is currently only supported for linux-chromium 3.18
# since other branches are missing the device tree source files (at least)
PREFERRED_PROVIDER_virtual/kernel ?= "linux-chromium"
PREFERRED_VERSION_linux-chromium ?= "3.%"

# U-boot on chromebooks "understands" fitImages built with an
# uncompressed kernel and the device tree blobs
KERNEL_IMAGETYPE_mediatek8173-chromebook = "fitImage"
KERNEL_CLASSES = "kernel-fitimage"
UBOOT_MKIMAGE_DTCOPTS = "-I dts -O dtb -p 2048"
FIT_HASH_ALG="sha256"

# Branch used for chromium tools, e.g. vboot, flashrom
CHROMIUM_THIRDPARTY_BRANCH = "release-R80-12739.B"
```

## conf/machine/x86-chromebook.conf
```bitbake
#@TYPE: Machine
#@NAME: x86-chromebook

#@DESCRIPTION: Machine configuration for 64 bit Intel Core i7 CPU (Generic at this point, based on meta-intel's TUNE)

# Keep the same structure as meta-intel
require conf/machine/include/meta-intel.inc
require conf/machine/include/intel-corei7-64-common.inc
require conf/machine/include/intel-common-pkgarch.inc


MACHINE_FEATURES += "pcbios efi"
MACHINE_FEATURES += "wifi 3g nfc"
MACHINE_FEATURES += "intel-ucode"

MACHINE_HWCODECS ?= "intel-vaapi-driver gstreamer1.0-vaapi"

# Enable optional dpdk:
COMPATIBLE_MACHINE_pn-dpdk = "x86-chromebook"

# Enable optional QAT items:
COMPATIBLE_MACHINE_pn-qat16 = "x86-chromebook"
COMPATIBLE_MACHINE_pn-qat17 = "x86-chromebook"
COMPATIBLE_MACHINE_pn-zlib-qat = "x86-chromebook"

XSERVER ?= "${XSERVER_X86_BASE} \
            ${XSERVER_X86_EXT} \
            ${XSERVER_X86_FBDEV} \
            ${XSERVER_X86_I915} \
            ${XSERVER_X86_I965} \
            ${XSERVER_X86_MODESETTING} \
            ${XSERVER_X86_VESA} \
            ${XSERVER_X86_ASPEED_AST} \
           "

SYSLINUX_OPTS = "serial 0 115200"
SERIAL_CONSOLES = "115200;ttyS0 115200;ttyS1 115200;ttyS2"
APPEND += "rootwait console=ttyS0,115200 console=tty0"

IMAGE_FSTYPES += "wic"
# WKS file that supports the legacy boot mode along with EFI
WKS_FILE="systemd-bootdisk-microcode-legacy.wks.in"
# Support only systemd-boot at this point, the chromebooks only allow you to boot in Legacy boot (BIOS) mode anyway.
# WKS_FILE ?= "${@bb.utils.contains_any("EFI_PROVIDER", "systemd-boot", "systemd-bootdisk-microcode.wks.in", "grub-bootdisk-microcode.wks.in", d)}"
WKS_FILE_DEPENDS_append = " intel-microcode"


# Since this MACHINE should work on most x86 chromebooks, we have to rely on kernel-modules being installed (these are set as extra on meta-intel, we put them on ESSENTIAL instead).
MACHINE_ESSENTIAL_EXTRA_RRECOMMENDS_append = " kernel-modules linux-firmware"


# Needed for QEMU, although at this point -cpu Skylake-{Slient,Server} has some issues
IMAGE_CLASSES += "qemuboot"

QB_SYSTEM_NAME_x86-chromebook = "qemu-system-x86_64"
QB_CPU_x86-chromebook = "-cpu Nehalem"
QB_CPU_KVM_x86-chromebook = "-cpu kvm64"

QB_AUDIO_DRV = "alsa"
QB_AUDIO_OPT = "-soundhw ac97,es1370"
QB_KERNEL_CMDLINE_APPEND = "vga=0 uvesafb.mode_option=640x480-32 oprofile.timer=1 uvesafb.task_timeout=-1"
# Add the 'virtio-rng-pci' device otherwise the guest may run out of entropy
QB_OPT_APPEND = "-vga vmware -show-cursor -usb -usbdevice tablet -device virtio-rng-pci"

# Not a huge fan of setting this on a MACHINE.conf, but apparently this is the
# way its wired in, setting it on an image recipe wouldn't work, and otherwise
# it would have to be set on several bbappends.
# This allows us to run Xorg as a non root user
ROOTLESS_X = "1"



# Support linux-intel and linux-yocto, but since this is generic keep linux-intel as default.
PREFERRED_PROVIDER_virtual/kernel ?= "linux-intel"
#PREFERRED_PROVIDER_virtual/kernel = "linux-yocto"

# Branch used for chromium tools, e.g. vboot, flashrom
CHROMIUM_THIRDPARTY_BRANCH = "release-R80-12739.B"

# Needed to build MrChromebox tools
CHROMIUM_CPU_VARIANT ?= "kbl"
```
